## Kconfig
```kconfig
menu "Raylib Lite Engine"

config RAYLIB_LITE_DEFAULT_FPS
    int "Default target frame rate"
    range 1 120
    default 30

config RAYLIB_LITE_MAX_TEXTURES
    int "Maximum simultaneously loaded atlases"
    range 1 32
    default 12

config RAYLIB_LITE_RASTER_PROFILE
    bool "Time triangle setup and raster stages"
    default n

config RAYLIB_LITE_RASTER_BENCHMARK
    bool "Run startup raster microbenchmarks"
    default n

endmenu
```

## components/mosaico_game_2d/Kconfig
```kconfig
menu "Mosaico Game 2D"

config MOSAICO_GAME_MAX_TEXTURES
    int "Maximum simultaneously loaded atlases"
    range 1 32
    default 12

config MOSAICO_GAME_RASTER_PROFILE
    bool "Time triangle setup and raster stages"
    default n
config MOSAICO_GAME_RASTER_BENCHMARK
    bool "Run startup raster microbenchmarks (Living Worlds)"
    default n
endmenu
```

## components/mosaico_game_app/Kconfig
```kconfig
menu "Mosaico game loop placement"
config MOSAICO_GAME_LOOP_CPU1
    bool "Run gameplay and rendering loop on CPU1"
    depends on !FREERTOS_UNICORE
    default n
    help
        Finish startup and the first display flush on the calling task, then
        run input, fixed updates and rendering on a dedicated CPU1 task.
        The caller waits until the loop exits. Uses an additional task stack
        equal to CONFIG_ESP_MAIN_TASK_STACK_SIZE. Benchmark before enabling.
endmenu
```

## examples/boards/esp-mosaico/Kconfig
```kconfig
config ESP_MOSAICO_EXAMPLE_IRIS
    bool "Enable Iris USB services in the native example"
    default y
    help
        Start Iris before the first frame and report healthy after that frame
        is accepted. mosaico.py install waits for this. Iris also redirects
        stdout/stderr to its log service. Turn this off only for a UART
        console; the running game then cannot complete an Iris install.
```

## examples/boards/esp-mosaico/sdkconfig.defaults
```kconfig
CONFIG_IDF_TARGET="esp32s31"
CONFIG_IDF_EXPERIMENTAL_FEATURES=y
CONFIG_SPIRAM=y
CONFIG_SPIRAM_SPEED_250M=y
CONFIG_SPIRAM_XIP_FROM_PSRAM=y
CONFIG_SPIRAM_MEMTEST=n
CONFIG_SPIRAM_USE_MALLOC=y
CONFIG_COMPILER_OPTIMIZATION_PERF=y
CONFIG_FREERTOS_HZ=1000
CONFIG_ESP_MAIN_TASK_STACK_SIZE=20480
CONFIG_ESPTOOLPY_FLASHSIZE_16MB=y
CONFIG_PARTITION_TABLE_CUSTOM=y
CONFIG_PARTITION_TABLE_CUSTOM_FILENAME="../boards/esp-mosaico/partitions.csv"

CONFIG_ESP_CONSOLE_UART_DEFAULT=y
# CONFIG_ESP_CONSOLE_USB_SERIAL_JTAG is not set
CONFIG_ESP_CONSOLE_SECONDARY_NONE=y
CONFIG_BSP_CO5300_ENABLE_TE=y
```

## examples/last_zone_extraction/main/Kconfig.projbuild
```kconfig
menu "Last Zone Extraction benchmark"

config LAST_ZONE_BENCHMARK_MODE
    bool "Run deterministic performance replay"
    default n
    help
        Drives Last Zone Extraction from a fixed input sequence derived from
        the logic tick and ignores touch, so raster and frame-time samples are
        comparable between builds. Use this only for repeatable device
        benchmarks, not normal gameplay.

config LAST_ZONE_TARGET_FPS
    int "Display frame-rate limit"
    range 30 60
    default 30
    help
        Rendering limit only; game logic remains fixed at 30 Hz.
        Set 60 when measuring available rendering headroom.

endmenu
```

## examples/living_worlds/main/Kconfig.projbuild
```kconfig
menu "Living Worlds benchmark"
config LIVING_WORLDS_BENCHMARK_MODE
    bool "Ignore touch during deterministic idle-camera replay"
    default n
    help
        Keeps the initial ocean scene and its tick-driven camera animation.
        Touch events are ignored so repeated boot runs are comparable.
endmenu
```

## examples/raylib_shooter/main/Kconfig.projbuild
```kconfig
menu "Mosaico Strike benchmark"

config RAYLIB_SHOOTER_BENCHMARK_MODE
    bool "Run deterministic performance replay"
    default n
    help
        Drives the shooter from a fixed input sequence instead of the IMU and
        ignores touch, so raster and frame-time samples are comparable
        between builds. Use this only for repeatable device benchmarks, not
        normal gameplay.

endmenu
```

## examples/sky_hop/main/Kconfig.projbuild
```kconfig
menu "Sky Hop"

config SKY_HOP_BENCHMARK_MODE
    bool "Run deterministic performance replay"
    default n
    help
        Starts and drives Sky Hop from a fixed input sequence. Use this only
        for repeatable device display benchmarks, not normal gameplay.

config SKY_HOP_TE_COMPOSE_BUFFERS
    int "TE compose buffer count"
    range 1 2
    default 2

config SKY_HOP_DRAWBUF_LINES
    int "Display draw-buffer lines"
    range 10 80
    default 80

config SKY_HOP_TARGET_FPS
    int "Display frame-rate limit"
    range 30 60
    default 60
    help
        Rendering limit only; game logic remains fixed at 30 Hz.
        The display pipeline applies backpressure when all frames are busy.

endmenu
```

## examples/tomb_explorer/main/Kconfig.projbuild
```kconfig
menu "Tomb Explorer benchmark"

config TOMB_EXPLORER_BENCHMARK_MODE
    bool "Run deterministic performance replay"
    default n
    help
        Drives Tomb Explorer from a fixed input sequence derived from the
        logic tick and ignores touch input, so raster and frame-time samples
        are comparable between builds. Use this only for repeatable device
        benchmarks, not normal gameplay.

endmenu
```

## examples/tower_defense/main/Kconfig.projbuild
```kconfig
menu "Tower Defense benchmark"

config TOWER_DEFENSE_BENCHMARK_MODE
    bool "Run deterministic performance replay"
    default n
    help
        Drives Tower Defense from a fixed input sequence derived from the
        logic tick and ignores touch, so raster and frame-time samples are
        comparable between builds. Use this only for repeatable device
        benchmarks, not normal gameplay.

endmenu
```
